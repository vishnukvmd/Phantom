## kernel/drivers/cpufreq/Kconfig
```kconfig
menu "CPU Frequency scaling"

config CPU_FREQ
	bool "CPU Frequency scaling"
	help
	  CPU Frequency scaling allows you to change the clock speed of 
	  CPUs on the fly. This is a nice method to save power, because 
	  the lower the CPU clock speed, the less power the CPU consumes.

	  Note that this driver doesn't automatically change the CPU
	  clock speed, you need to either enable a dynamic cpufreq governor
	  (see below) after boot, or use a userspace tool.

	  For details, take a look at <file:Documentation/cpu-freq>.

	  If in doubt, say N.

if CPU_FREQ

config CPU_FREQ_TABLE
	tristate

config CPU_FREQ_STAT
	tristate "CPU frequency translation statistics"
	select CPU_FREQ_TABLE
	default y
	help
	  This driver exports CPU frequency statistics information through sysfs
	  file system.

	  To compile this driver as a module, choose M here: the
	  module will be called cpufreq_stats.

	  If in doubt, say N.

config CPU_FREQ_STAT_DETAILS
	bool "CPU frequency translation statistics details"
	depends on CPU_FREQ_STAT
	help
	  This will show detail CPU frequency translation table in sysfs file
	  system.

	  If in doubt, say N.

 	choice
	prompt "Default CPUFreq governor"
	default CPU_FREQ_DEFAULT_GOV_USERSPACE if CPU_FREQ_SA1100 || CPU_FREQ_SA1110
	default CPU_FREQ_DEFAULT_GOV_PERFORMANCE
	help
	  This option sets which CPUFreq governor shall be loaded at
	  startup. If in doubt, select 'performance'.

config CPU_FREQ_DEFAULT_GOV_PERFORMANCE
	bool "performance"
	select CPU_FREQ_GOV_PERFORMANCE
	help
	  Use the CPUFreq governor 'performance' as default. This sets
	  the frequency statically to the highest frequency supported by
	  the CPU.

config CPU_FREQ_DEFAULT_GOV_POWERSAVE
	bool "powersave"
	depends on EMBEDDED
	select CPU_FREQ_GOV_POWERSAVE
	help
	  Use the CPUFreq governor 'powersave' as default. This sets
	  the frequency statically to the lowest frequency supported by
	  the CPU.

config CPU_FREQ_DEFAULT_GOV_USERSPACE
	bool "userspace"
	select CPU_FREQ_GOV_USERSPACE
	help
	  Use the CPUFreq governor 'userspace' as default. This allows
	  you to set the CPU frequency manually or when a userspace 
	  program shall be able to set the CPU dynamically without having
	  to enable the userspace governor manually.

config CPU_FREQ_DEFAULT_GOV_ONDEMAND
	bool "ondemand"
	select CPU_FREQ_GOV_ONDEMAND
	select CPU_FREQ_GOV_PERFORMANCE
	help
	  Use the CPUFreq governor 'ondemand' as default. This allows
	  you to get a full dynamic frequency capable system by simply
	  loading your cpufreq low-level hardware driver.
	  Be aware that not all cpufreq drivers support the ondemand
	  governor. If unsure have a look at the help section of the
	  driver. Fallback governor will be the performance governor.

config CPU_FREQ_DEFAULT_GOV_CONSERVATIVE
	bool "conservative"
	select CPU_FREQ_GOV_CONSERVATIVE
	select CPU_FREQ_GOV_PERFORMANCE
	help
	  Use the CPUFreq governor 'conservative' as default. This allows
	  you to get a full dynamic frequency capable system by simply
	  loading your cpufreq low-level hardware driver.
	  Be aware that not all cpufreq drivers support the conservative
	  governor. If unsure have a look at the help section of the
	  driver. Fallback governor will be the performance governor.

config CPU_FREQ_DEFAULT_GOV_SMARTASS2
       bool "smartass2"
       select CPU_FREQ_GOV_SMARTASS2
       help
        Use the CPUFreq governor 'smartassV2' as default.

config CPU_FREQ_DEFAULT_GOV_INTERACTIVE
       bool "interactive"
       select CPU_FREQ_GOV_INTERACTIVE
       help
        Use the 'interactive' governor as default. This gets full cpu frequency
        scaling for workloads that are latency sensitive, typically interactive
        workloads...

config CPU_FREQ_DEFAULT_GOV_PEGASUSQ
	bool "pegasusq"
	select CPU_FREQ_GOV_PEGASUSQ

config CPU_FREQ_DEFAULT_GOV_WHEATLEY
	bool "wheatley"
	select CPU_FREQ_GOV_WHEATLEY
 	select CPU_FREQ_GOV_PERFORMANCE
    	help
     	 Use the CPUFreq governor 'wheatley' as default.

config CPU_FREQ_DEFAULT_GOV_SAKURACTIVE
	bool "sakuractive"
	select CPU_FREQ_GOV_SAKURACTIVE
	select CPU_FREQ_GOV_PERFORMANCE
	help
	 Use the CPUFreq governor 'sakuractive' as default. This allows you
	 to get a full dynamic frequency capable system with CPU
	 hotplug support by simply loading your cpufreq low-level
	 hardware driver. Be aware that not all cpufreq drivers
	 support the hotplug governor. If unsure have a look at
	 the help section of the driver. Fallback governor will be the
	 performance governor.

config CPU_FREQ_DEFAULT_GOV_NIGHTMARE
	bool "nightmare"
	select CPU_FREQ_GOV_NIGHTMARE

config CPU_FREQ_DEFAULT_GOV_MINMAX
	bool "minmax"
	select CPU_FREQ_GOV_MINMAX
	select CPU_FREQ_GOV_PERFORMANCE
	help
	  Use the CPUFreq governor 'minmax' as default. This minimizes the
	  frequency jumps does by the governor. This is aimed at maximizing
	  both perfomance and battery life.

config CPU_FREQ_DEFAULT_GOV_INTELLIDEMAND
	bool "intellidemand"
	select CPU_FREQ_GOV_INTELLIDEMAND
    	select CPU_FREQ_GOV_PERFORMANCE
    	help
     	  Intelligent OnDemand Govneror based on Samsung Patched OnDemand

config CPU_FREQ_DEFAULT_GOV_HOTPLUG
	bool "hotplug"
	select CPU_FREQ_GOV_HOTPLUG
	select CPU_FREQ_GOV_PERFORMANCE
	help
	  Use the CPUFreq governor 'hotplug' as default. This allows you
	  to get a full dynamic frequency capable system with CPU
	  hotplug support by simply loading your cpufreq low-level
	  hardware driver.  Be aware that not all cpufreq drivers
	  support the hotplug governor. If unsure have a look at
	  the help section of the driver. Fallback governor will be the
	  performance governor.

config CPU_FREQ_DEFAULT_GOV_LULZACTIVEQ
	bool "lulzactiveq"
	select CPU_FREQ_GOV_LULZACTIVEQ
	help

config CPU_FREQ_DEFAULT_GOV_INTERACTIVEX
       bool "interactiveX"
       select CPU_FREQ_GOV_INTERACTIVEX
       help
         Use the CPUFreq governor 'interactiveX' as default. This allows
         you to get a full dynamic cpu frequency capable system by simply
         loading your cpufreq low-level hardware driver, using the
         'interactiveX' governor for latency-sensitive workloads.

config CPU_FREQ_DEFAULT_GOV_INTERACTIVETEST
       bool "interactiveTEST"
       select CPU_FREQ_GOV_INTERACTIVETEST
       help
         Use the CPUFreq governor 'interactiveTEST' as default. This allows
         you to get a full dynamic cpu frequency capable system by simply
         loading your cpufreq low-level hardware driver, using the
         'interactiveTEST' governor for latency-sensitive workloads.

config CPU_FREQ_DEFAULT_GOV_HYPER
        bool "HYPER"
        select CPU_FREQ_GOV_HYPER
        ---help---
          Use the CPUFreq governor 'HYPER' as default.

config CPU_FREQ_DEFAULT_GOV_LULZACTIVEQ
	bool "lulzactiveq"
	select CPU_FREQ_GOV_LULZACTIVEQ

config CPU_FREQ_DEFAULT_GOV_LIONHEART
        bool "lionheart"
        select CPU_FREQ_GOV_LIONHEART	
        help
         If in doubt, say N.
		 
endchoice

config CPU_FREQ_GOV_PERFORMANCE
	tristate "'performance' governor"
	help
	  This cpufreq governor sets the frequency statically to the
	  highest available CPU frequency.

	  To compile this driver as a module, choose M here: the
	  module will be called cpufreq_performance.

	  If in doubt, say Y.

config CPU_FREQ_GOV_POWERSAVE
	tristate "'powersave' governor"
	help
	  This cpufreq governor sets the frequency statically to the
	  lowest available CPU frequency.

	  To compile this driver as a module, choose M here: the
	  module will be called cpufreq_powersave.

	  If in doubt, say Y.

config CPU_FREQ_GOV_USERSPACE
	tristate "'userspace' governor for userspace frequency scaling"
	help
	  Enable this cpufreq governor when you either want to set the
	  CPU frequency manually or when a userspace program shall
	  be able to set the CPU dynamically, like on LART 
	  <http://www.lartmaker.nl/>.

	  To compile this driver as a module, choose M here: the
	  module will be called cpufreq_userspace.

	  For details, take a look at <file:Documentation/cpu-freq/>.

	  If in doubt, say Y.

config CPU_FREQ_GOV_ONDEMAND
	tristate "'ondemand' cpufreq policy governor"
	select CPU_FREQ_TABLE
	help
	  'ondemand' - This driver adds a dynamic cpufreq policy governor.
	  The governor does a periodic polling and 
	  changes frequency based on the CPU utilization.
	  The support for this governor depends on CPU capability to
	  do fast frequency switching (i.e, very low latency frequency
	  transitions). 

	  To compile this driver as a module, choose M here: the
	  module will be called cpufreq_ondemand.

	  For details, take a look at linux/Documentation/cpu-freq.

	  If in doubt, say N.

config CPU_FREQ_GOV_CONSERVATIVE
	tristate "'conservative' cpufreq governor"
	depends on CPU_FREQ
	help
	  'conservative' - this driver is rather similar to the 'ondemand'
	  governor both in its source code and its purpose, the difference is
	  its optimisation for better suitability in a battery powered
	  environment.  The frequency is gracefully increased and decreased
	  rather than jumping to 100% when speed is required.

	  If you have a desktop machine then you should really be considering
	  the 'ondemand' governor instead, however if you are using a laptop,
	  PDA or even an AMD64 based computer (due to the unacceptable
	  step-by-step latency issues between the minimum and maximum frequency
	  transitions in the CPU) you will probably want to use this governor.

	  To compile this driver as a module, choose M here: the
	  module will be called cpufreq_conservative.

	  For details, take a look at linux/Documentation/cpu-freq.

	  If in doubt, say N.

config CPU_FREQ_GOV_DYNAMIC_INTERACTIVE
	tristate "'dynamic interactive' cpufreq policy governor"
	help
	  'dynamic interactive' - This driver adds a dynamic cpufreq policy governor
	  designed for latency-sensitive workloads.

	  This governor attempts to reduce the latency of clock
	  increases so that the system is more responsive to
	  interactive workloads.

	  To compile this driver as a module, choose M here: the
	  module will be called cpufreq_interactive.

	  For details, take a look at linux/Documentation/cpu-freq.

	  If in doubt, say N.

config CPU_FREQ_GOV_SMARTASS2
       tristate "'smartassV2' cpufreq governor"
       depends on CPU_FREQ
       help
         'smartassV2' - a "smart" optimized governor for the pyra!

config CPU_FREQ_GOV_INTERACTIVE
       tristate "'interactive' cpufreq policy governor"
       help
         'interactive' - This driver adds a dynamic cpufreq policy governor.
          Designed for low latency burst workloads. Scaling it done when coming
          out of idle instead of polling.

config CPU_FREQ_GOV_PEGASUSQ
	tristate "'pegasusq' cpufreq policy governor"

config CPU_FREQ_GOV_WHEATLEY
	tristate "'wheatley' cpufreq governor"
	depends on CPU_FREQ

config CPU_FREQ_GOV_SAKURACTIVE
	tristate "'sakuractive' cpufreq governor"
	depends on CPU_FREQ && NO_HZ && HOTPLUG_CPU
	help
	 'sakuractive' - this driver mimics the frequency scaling behavior
	 in 'ondemand', but with several key differences. First is
	 that frequency transitions use the CPUFreq table directly,
 	 instead of incrementing in a percentage of the maximum
	 available frequency. Second 'sakuractive' will offline auxillary
	 CPUs when the system is idle, and online those CPUs once the
	 system becomes busy again. This last feature is needed for
	 architectures which transition to low power states when only
	 the "master" CPU is online, or for thermally constrained
	 devices.
	 If you don't have one of these architectures or devices, use
	 'ondemand' instead.
	 If in doubt, say N.

config CPU_FREQ_GOV_NIGHTMARE
	tristate "'nightmare' cpufreq policy governor"

config CPU_FREQ_GOV_MINMAX
	tristate "'minmax' cpufreq governor"
	depends on CPU_FREQ
	help
	  'minmax' - this driver tries to minimize the frequency jumps by limiting
	  the the selected frequencies to either the min or the max frequency of
	  the policy. The frequency is selected according to the load.

	  If in doubt, say N.

config CPU_FREQ_GOV_INTELLIDEMAND
	tristate "'intellidemand' cpufreq governor"
	depends on CPU_FREQ
	help
	  'intellidemand' - an intelligent ondemand governor

config CPU_FREQ_GOV_HOTPLUG
       tristate "'hotplug' cpufreq governor"
       depends on CPU_FREQ && NO_HZ && HOTPLUG_CPU
       help
         'hotplug' - this driver mimics the frequency scaling behavior
         in 'ondemand', but with several key differences.  First is
         that frequency transitions use the CPUFreq table directly,
         instead of incrementing in a percentage of the maximum
         available frequency.  Second 'hotplug' will offline auxillary
         CPUs when the system is idle, and online those CPUs once the
         system becomes busy again.  This last feature is needed for
         architectures which transition to low power states when only
         the "master" CPU is online, or for thermally constrained
         devices.

         If you don't have one of these architectures or devices, use
         'ondemand' instead.

         If in doubt, say N.

config CPU_FREQ_GOV_HYPER
        tristate "'HYPER' cpufreq governor"
        depends on CPU_FREQ
        ---help---
          'HYPER' - a tweaked "ondemand" based smart and smooth optimized governor!

           If in doubt, say Y.


config CPU_FREQ_GOV_INTERACTIVEX
       tristate "'interactiveX' cpufreq policy governor"
       help
         'interactiveX' - Modified version of interactive with sleep+wake code.

config CPU_FREQ_GOV_INTERACTIVETEST
       tristate "'interactiveTEST' cpufreq policy governor"
       help
         'interactiveTEST' - Modified version of interactive with sleep+wake code.


config CPU_FREQ_GOV_LULZACTIVEQ
        tristate "'lulzactiveq' cpufreq governor"
        depends on CPU_FREQ
        help
          'lulzactiveq' - hotplug mechanism added in lulzactive

config CPU_FREQ_GOV_SLP
	tristate "'slp' cpufreq policy governor"

config CPU_FREQ_GOV_LULZACTIVEQ
	tristate "'lulzactiveq' cpufreq governor"
	depends on CPU_FREQ
	---help---
	  'lulzactiveq' - NEW hotplug mechanism added in lulzactive
	   
config CPU_FREQ_GOV_LIONHEART
        tristate "'lionheart' cpufreq governor"
        depends on CPU_FREQ
        help

          If in doubt, say N.

menu "x86 CPU frequency scaling drivers"
depends on X86
source "drivers/cpufreq/Kconfig.x86"
endmenu

endif
endmenu
```
